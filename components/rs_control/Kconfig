## components/rs_control/Kconfig
```kconfig
menu "Room Sense — Remote control"

config RS_CONTROL_PORT
    int "Remote control UDP port"
    range 1024 65535
    default 5052
    help
        UDP port the board listens on for remote commands (TRAIN_START,
        OTA_NOW, REBOOT, etc.). The dashboard or a CLI tool sends ASCII
        line-oriented datagrams to this port.

endmenu
```

## components/rs_crash/Kconfig
```kconfig
menu "Room Sense — Crash uploader"

config RS_CRASH_UPLOAD_URL_PREFIX
    string "Coredump upload URL prefix"
    default "http://10.0.0.70:5050/api/coredump"
    help
        The board appends '/<board_mac>' to this prefix and PUTs the raw
        coredump bytes. Must match the backend's /api/coredump/<mac>
        endpoint.

endmenu
```

## components/rs_ota/Kconfig
```kconfig
menu "Room Sense — OTA updater"

config RS_OTA_MANIFEST_URL
    string "Firmware manifest URL"
    default "http://10.0.0.70:5050/firmware/manifest.json"
    help
        URL the OTA task polls for new firmware. Must serve a small JSON
        object with at least "version" and "url" fields.

config RS_OTA_CHECK_INTERVAL_S
    int "Check interval (seconds)"
    range 60 86400
    default 3600
    help
        How often to poll the manifest URL. Default: 1 hour.

endmenu
```

## components/rs_radar/Kconfig
```kconfig
menu "Room Sense — Radar (LD2410C)"

config RS_RADAR_UART_NUM
    int "UART port number"
    range 0 2
    default 1
    help
        Which UART peripheral to use. UART0 is the console; pick 1 or 2.

config RS_RADAR_RX_GPIO
    int "ESP RX pin (radar's TX connects here)"
    default 18
    help
        GPIO that receives bytes FROM the radar.

config RS_RADAR_TX_GPIO
    int "ESP TX pin (connects to radar's RX)"
    default 17
    help
        GPIO that sends bytes TO the radar.

config RS_RADAR_BAUD
    int "UART baud rate"
    default 256000
    help
        LD2410C ships with 256000 baud by default. Reconfigure via the
        radar's command interface to change.

endmenu
```

## components/rs_telemetry/Kconfig
```kconfig
menu "Room Sense — Telemetry"

config RS_TELEMETRY_HOST_IP
    string "Backend host IP"
    default "10.0.0.70"
    help
        IPv4 address of the Room Sense backend that receives UDP packets.

config RS_TELEMETRY_HOST_PORT
    int "Backend UDP port"
    range 1 65535
    default 5051
    help
        UDP port the backend listens on. Must match csi_udp_receiver.py.

endmenu
```
